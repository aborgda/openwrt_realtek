// SPDX-License-Identifier: GPL-2.0
/dts-v1/;
#include "rtl819x.dtsi"
/ {
	model = "GN866 AC (RTL8198C + RTL8192ER + RTL8812BRH)";
	compatible = "realtek,rtl8198c-gn866-ac", "realtek,rtl819x-soc";
	memory@0 { device_type = "memory"; reg = <0x00000000 0x08000000>; };
	chosen { bootargs = "console=ttyS0,115200"; };
};
